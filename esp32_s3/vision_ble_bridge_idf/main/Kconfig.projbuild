## esp32_s3/vision_ble_bridge_idf/main/Kconfig.projbuild
```kconfig
menu "PetLink Vision Bridge Configuration"
    config PETLINK_WIFI_SSID
        string "Default Wi-Fi SSID (optional, leave empty for USB-Serial bridge only)"
        default ""

    config PETLINK_WIFI_PASS
        string "Default Wi-Fi Password"
        default ""

    config PETLINK_UDP_PORT
        int "UDP listen port"
        default 9000

    config PETLINK_TJC_TX_GPIO
        int "TJC screen TX GPIO (ESP32 TX -> screen RX)"
        range 0 48
        default 18

    config PETLINK_TJC_RX_GPIO
        int "TJC screen RX GPIO (screen TX -> ESP32 RX)"
        range 0 48
        default 21

    config PETLINK_TJC_BAUD
        int "TJC screen baud rate"
        range 1200 921600
        default 9600

    config PETLINK_BCLK_GPIO
        int "INMP441 BCLK GPIO"
        range 0 48
        default 4

    config PETLINK_WS_GPIO
        int "INMP441 WS GPIO"
        range 0 48
        default 5

    config PETLINK_SD_GPIO
        int "INMP441 SD GPIO"
        range 0 48
        default 6

    config PETLINK_I2S_HIGH_ALIGNED
        bool "24-bit microphone sample is in high 24 bits of received word"
        default y

    config PETLINK_DEMO_ALWAYS_OUTPUT
        bool "Compute ranked emotion candidate even when frozen gates reject"
        default y
endmenu
```

## esp32_s3/vision_ble_bridge_idf/sdkconfig.defaults
```kconfig
CONFIG_IDF_TARGET="esp32s3"
CONFIG_ESPTOOLPY_FLASHSIZE_8MB=y
CONFIG_ESPTOOLPY_FLASHMODE_DIO=y
CONFIG_ESPTOOLPY_FLASHFREQ_40M=y
CONFIG_SPIRAM=y
CONFIG_SPIRAM_MODE_QUAD=y
CONFIG_SPIRAM_TYPE_AUTO=y
CONFIG_SPIRAM_SPEED_40M=y
CONFIG_SPIRAM_BOOT_INIT=y
CONFIG_SPIRAM_MEMTEST=y
CONFIG_SPIRAM_USE_MALLOC=y
CONFIG_PARTITION_TABLE_CUSTOM=y
CONFIG_PARTITION_TABLE_CUSTOM_FILENAME="partitions.csv"
CONFIG_ESP_CONSOLE_UART_DEFAULT=y
CONFIG_ESP_CONSOLE_UART_BAUDRATE=115200
CONFIG_ESP_MAIN_TASK_STACK_SIZE=16384
CONFIG_ESP_TASK_WDT_TIMEOUT_S=10
CONFIG_COMPILER_OPTIMIZATION_PERF=y
CONFIG_BT_ENABLED=y
CONFIG_BT_NIMBLE_ENABLED=y
CONFIG_BT_NIMBLE_ATT_PREFERRED_MTU=256
CONFIG_BT_NIMBLE_MAX_CONNECTIONS=1
CONFIG_ESP_WIFI_ENABLED=y
```
